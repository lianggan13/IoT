/**************************************************************************************
*		              EEPROM-IIC实验												  *
实现现象：具体接线操作请看视频。
          下载程序后数码管后4位显示0，按K1保存显示的数据，按K2读取上次保存的数据，
          按K3显示数据加一，按K4显示数据清零。最大能写入的数据是255.

注意事项：由于P3.2口跟红外线共用，所以做按键实验时为了不让红外线影响实验效果，最好把红外线先取下来。
***************************************************************************************/

#include "reg52.h" //此文件中定义了单片机的一些特殊功能寄存器
#include "i2c.h"
#include "EEPROM.h"
#include "../Utility/delay.h"
#include "../Utility/CommData.h"
#include "../LED/DynamicLed.h"

typedef unsigned int u16; // 对数据类型进行声明定义
typedef unsigned char u8;

sbit k1 = P3 ^ 0; // 保存数据
sbit k2 = P3 ^ 1; // 读取数据
sbit k3 = P3 ^ 2; // 累加数据
sbit k4 = P3 ^ 3; // 清零数据

char num = 0;

/*******************************************************************************
 * 函数名         :Keypros()
 * 函数功能		 :按键处理函数
 * 输入           : 无
 * 输出         	 : 无
 *******************************************************************************/
void Keypros()
{
    if (k1 == 0)
    {
        delay_ms(10); // 消抖处理
        if (k1 == 0)
        {
            At24c02Write(1, num); // 在地址1内写入数据num
        }
        while (!k1)
            ;
    }
    if (k2 == 0)
    {
        delay_ms(10); // 消抖处理
        if (k2 == 0)
        {
            num = At24c02Read(1); // 读取EEPROM地址1内的数据保存在num中
        }
        while (!k2)
            ;
    }
    if (k3 == 0)
    {
        delay_ms(10); // 消抖处理
        if (k3 == 0)
        {
            num++; // 数据加1
            if (num > 255)
                num = 0;
        }
        while (!k3)
            ;
    }
    if (k4 == 0)
    {
        delay_ms(10); // 消抖处理
        if (k4 == 0)
        {
            num = 0; // 数据清零
        }
        while (!k4)
            ;
    }
}

/*******************************************************************************
 * 函数名         :datapros()
 * 函数功能		 :数据处理函数
 * 输入           : 无
 * 输出         	 : 无
 *******************************************************************************/
void datapros()
{
    DisplayData[0] = smgduan[num / 1000];            // 千位
    DisplayData[1] = smgduan[num % 1000 / 100];      // 百位
    DisplayData[2] = smgduan[num % 1000 % 100 / 10]; // 个位
    DisplayData[3] = smgduan[num % 1000 % 100 % 10];
}

/*******************************************************************************
 * 函 数 名       : main
 * 函数功能		 : 主函数
 * 输    入       : 无
 * 输    出    	 : 无
 *******************************************************************************/
void TestEEPROM()
{
    while (1)
    {
        Keypros();    // 按键处理函数
        datapros();   // 数据处理函数
        DigDisplay(); // 数码管显示函数
    }
}
